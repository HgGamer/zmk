## app/dts/bindings/zmk,input-configs.yaml
```yaml
description: |
  Allows post-processing of input events based on the configuration

compatible: "zmk,input-configs"

child-binding:
  description: "A configuration for a given input device"

  properties:
    device:
      type: phandle
      required: true
    xy-swap:
      type: boolean
    x-invert:
      type: boolean
    y-invert:
      type: boolean
    scale-multiplier:
      type: int
      default: 1
    scale-divisor:
      type: int
      default: 1
    layer-toggle:
      type: int
      default: -1
      required: false
      description: The layer that should be toggled when the mouse is moved.
    layer-toggle-delay-ms:
      type: int
      default: 250
      required: false
      description: How many miliseconds of mouse activity are required before the layer is toggled on.
    layer-toggle-timeout-ms:
      type: int
      default: 250
      required: false
      description: How many miliseconds of mouse inactivity are required before the layer is toggled off again.
```

## app/west.yml
```yaml
manifest:
  remotes:
    - name: zephyrproject-rtos
      url-base: https://github.com/zephyrproject-rtos
    - name: zmkfirmware
      url-base: https://github.com/zmkfirmware
    - name: petejohanson
      url-base: https://github.com/petejohanson
    - name: infused-kim
      url-base: https://github.com/infused-kim
  projects:
    - name: zmk-zephyr
      path: zephyr
      remote: infused-kim
      revision: dev/ps2_uart_z3.5
      clone-depth: 1
      import:
        name-blocklist:
          - ci-tools
          - hal_altera
          - hal_cypress
          - hal_infineon
          - hal_microchip
          - hal_nxp
          - hal_openisa
          - hal_silabs
          - hal_xtensa
          - hal_st
          - hal_ti
          - loramac-node
          - mcuboot
          - mcumgr
          - net-tools
          - openthread
          - edtt
          - trusted-firmware-m
  self:
    west-commands: scripts/west-commands.yml
```
